## CMakeLists.txt
```
# SPDX-License-Identifier: Apache-2.0

cmake_minimum_required(VERSION 3.20.0)

find_package(Zephyr REQUIRED HINTS $ENV{ZEPHYR_BASE})
project(mlonmcu_template)
SET(CMAKE_MODULE_PATH ${CMAKE_MODULE_PATH} "${CMAKE_CURRENT_SOURCE_DIR}/cmake")

SET(TVM_ALIGNMENT_BYTES 4)

# cmake-format: off
SET(TVM_HEADERS
    ${CONFIG_TVM_DIR}/include
    ${CONFIG_TVM_DIR}/3rdparty/dlpack/include
    ${CONFIG_TVM_DIR}/apps/bundle_deploy
    ${CONFIG_TVM_DIR}/src/runtime/crt/include
)
# cmake-format: on

IF(CONFIG_TVM_CRT_CONFIG_DIR)
    LIST(APPEND TVM_HEADERS ${CONFIG_TVM_CRT_CONFIG_DIR})
ELSE()
    LIST(APPEND TVM_HEADERS ${CONFIG_TVM_DIR}/apps/bundle_deploy/crt_config)
ENDIF()

INCLUDE(backends/${CONFIG_MLONMCU_BACKEND})
INCLUDE(frameworks/${CONFIG_MLONMCU_FRAMEWORK})

TARGET_INCLUDE_DIRECTORIES(app PUBLIC ${TVM_HEADERS})

TARGET_COMPILE_DEFINITIONS(app PUBLIC
    -DTVM_RUNTIME_ALLOC_ALIGNMENT_BYTES=${TVM_ALIGNMENT_BYTES}
)



INCLUDE(extras)

INCLUDE(frameworks/${CONFIG_MLONMCU_FRAMEWORK}_mlif)

IF(CONFIG_MODEL_DIR)
    GET_FILENAME_COMPONENT(MODEL_SUPPORT_DIR ${CONFIG_MODEL_DIR}/support REALPATH)
    GET_FILENAME_COMPONENT(MODEL_NAME ${CONFIG_MODEL_DIR} NAME)
ENDIF()

IF(MODEL_SUPPORT_DIR AND EXISTS ${MODEL_SUPPORT_DIR})
    ADD_SUBDIRECTORY(${MODEL_SUPPORT_DIR} model_support_bin_${MODEL_NAME})
ELSE()
    ADD_SUBDIRECTORY(default_model_support)
ENDIF()

IF(NOT CONFIG_DATA_SRC)
    SET(CONFIG_DATA_SRC "default_data.c")
ENDIF()

IF(CONFIG_NUM_RUNS)
    TARGET_COMPILE_DEFINITIONS(${PROJECT_NAME} PUBLIC NUM_RUNS=${CONFIG_NUM_RUNS})
ENDIF()

TARGET_INCLUDE_DIRECTORIES(app PUBLIC ${TVM_HEADERS} ${TVM_OUT_DIR}/include ${CONFIG_MLONMCU_CODEGEN_DIR} lib/support)
SET(TVM_WRAPPER_FILENAME aot_wrapper.c)
SET(EXTRA_SRC ${EXTRA_SRC} ${CONFIG_MLONMCU_CODEGEN_DIR}/${TVM_WRAPPER_FILENAME})
target_sources(app PRIVATE
    src/main.c
    ml_interface.c
    ${CONFIG_TVM_DIR}/src/runtime/crt/common/crt_backend_api.c
    ${CONFIG_TVM_DIR}/src/runtime/crt/memory/stack_allocator.c
    ${CONFIG_DATA_SRC}
    ${EXTRA_SRC}
    ${TVM_SRCS}
)
target_link_libraries(app PRIVATE model_support)
```

## prj.conf
```kconfig
CONFIG_CPLUSPLUS=y
CONFIG_NEWLIB_LIBC=y
CONFIG_REBOOT=y
CONFIG_STD_CPP20=y
CONFIG_LIB_CPLUSPLUS=y
CONFIG_TIMING_FUNCTIONS=y
CONFIG_DEBUG=n
CONFIG_MLONMCU_CODEGEN_DIR="/nas/ei/share/TUEIEDAscratch/ga87puy/work/mlonmcu/workspace/temp/sessions/152/runs/0"
CONFIG_MLONMCU_BACKEND="tvmaot"
CONFIG_MLONMCU_FRAMEWORK="tvm"
CONFIG_TVM_CRT_CONFIG_DIR="/nas/ei/share/TUEIEDAscratch/ga87puy/work/mlonmcu/mlonmcu/../resources/frameworks/tvm/crt_config"
CONFIG_TVM_DIR="/nas/ei/share/TUEIEDAscratch/ga87puy/work/mlonmcu/workspace/deps/src/tvm"
CONFIG_COMPILER_OPT="-O2"
```

## src/main.c
```c
/*
 * Copyright (c) 2012-2014 Wind River Systems, Inc.
 *
 * SPDX-License-Identifier: Apache-2.0
 */

#include <zephyr.h>
#include <stdint.h>
#include <sys/printk.h>
#include <sys/reboot.h>
#include <timing/timing.h>
// #include <zephyr/kernel.h>

// void init_target();
// void deinit_target();

int main() {
  // init_target();
  timing_init();
  timing_start();
  printk("MLonMCU: START\n");
  timing_t start_time, end_time;
  start_time = timing_counter_get();
  mlif_run();
  end_time = timing_counter_get();
  uint64_t cycles = timing_cycles_get(&start_time, &end_time);
  uint64_t ns_spent = timing_cycles_to_ns(cycles);

  printk("Total Time: %llu us\n", (ns_spent/1000));
  printk("Total Cycles: %llu\n", cycles);
  printk("MLonMCU: STOP\n");
  // deinit_target();
  sys_reboot(0);
  return 0;
}
```
