## Kconfig
```
mainmenu "MLonMCU"

source "Kconfig.zephyr"
menu "MLonMCU Options"

    config MLONMCU_CODEGEN_DIR
        string "Codegen Directory"
        default "$(CODEGEN_SRC)"
        help
            Path to the directory with the codegen results.

    # choice MLONMCU_FRAMEWORK
    #     prompt "MLonMCU framework"
    #     default MLONMCU_FRAMEWORK_TFLM
    #     help
    #         Choose a MLonMCU framework from the list.

    #     config MLONMCU_FRAMEWORK_TFLM
    #         bool "TFLite Micro"
    #     config MLONMCU_FRAMEWORK_TVM
    #         bool "TVM"
    # endchoice

    config MLONMCU_FRAMEWORK
        string "Ued Framework"
        # default "tflm" if MLONMCU_FRAMEWORK_TFLM
        # default "tvm" if MLONMCU_FRAMEWORK_TVM
        default "none"
        help
            TODO

    # choice MLONMCU_BACKEND
    #     prompt "MLonMCU backend"
    #     default MLONMCU_BACKEND_TFLMI if MLONMCU_FRAMEWORK_TFLM
    #     default MLONMCU_BACKEND_TVMAOT if MLONMCU_FRAMEWORK_TVM
    #     help
    #         Choose a MLonMCU backend for the chosen framwork.

    #     config MLONMCU_BACKEND_TFLMI
    #         bool "TFLite Micro Default Interpreter"
    #         depends on MLONMCU_FRAMEWORK_TFLM
    #     config MLONMCU_BACKEND_TFLMC
    #         bool "TFLite Micro Compiler"
    #         depends on MLONMCU_FRAMEWORK_TFLM
    #     config MLONMCU_BACKEND_TVMAOT
    #         bool "TVM AoT Executor"
    #         depends on MLONMCU_FRAMEWORK_TVM
    #     config MLONMCU_BACKEND_TVMRT
    #         bool "TVM Graph Executor"
    #         depends on MLONMCU_FRAMEWORK_TVM
    #     config MLONMCU_BACKEND_TVMCG
    #         bool "TVM Custom Codegenerator"
    #         depends on MLONMCU_FRAMEWORK_TVM
    # endchoice

    config MLONMCU_BACKEND
        string "Used backend"
        default "none"
        help
            TODO

    config MLONMCU_NUM_RUNS
        int "Number of inferences"
        default 1
        help
            How many times the network should be invoked. A negative value maps to a infinite number of runs.

    config MLONMCU_VALIDATE
        bool "Validate model output data"
        default false
        help
            Compare model outputs with expected results (if available). Only works in DEBUG mode.

    config MLONMCU_MODLE_DIR
        string "Model Directory"
        depends on MLONMCU_VALIDATE
        default "$(MODEL_DIR)"
        help
            Directory where model support code and reference data can be found.
endmenu

menu "TVM Build Options"
    config TVM_DIR
        string "Path to TVM"
        default "$(TVM_SRC)"
        help
            TVM directory path.
    config TVM_CRT_CONFIG_DIR
        string "Path to TVM CRT config directory"
        default ""
        help
            TVM crt path.
endmenu
menu "TFLite Micro Build Options"

    config TF_DIR
        string "Path to TFLite Micro"
        default "$(TF_SRC)"
        help
            TFLite Micro directory path.
endmenu
```

## prj.conf
```kconfig
CONFIG_NEWLIB_LIBC=n
CONFIG_MLONMCU_FRAMEWORK="tvm"
CONFIG_MLONMCU_BACKEND="tvmaot"
CONFIG_TVM_DIR="/nas/ei/share/TUEIEDAscratch/ga87puy/work/mlonmcu/workspace/deps/src/tvm"
CONFIG_MLONMCU_CODEGEN_DIR="/work/tools/zephyr_stuff/run/"
CONFIG_CPLUSPLUS=y
CONFIG_STD_CPP17=y
CONFIG_LIB_CPLUSPLUS=y
CONFIG_EXCEPTIONS=y
```

## src/main.c
```c
/*
 * Copyright (c) 2012-2014 Wind River Systems, Inc.
 *
 * SPDX-License-Identifier: Apache-2.0
 */

#include <zephyr.h>
#include <stdint.h>
#include <sys/printk.h>
#include <sys/reboot.h>
#include <timing/timing.h>
// #include <zephyr/kernel.h>

// void init_target();
// void deinit_target();

int main() {
  // init_target();
  timing_init();
  timing_start();
  printk("MLonMCU: START\n");
  // uint32_t start_time;
  // uint32_t start_time_;
  // uint32_t stop_time;
  // uint32_t stop_time_;
  // uint32_t cycles_spent;
  // uint64_t cycles_spent_;
  // uint32_t nanoseconds_spent;
  // uint64_t nanoseconds_spent_;
  /* capture initial time stamp */
  // start_time = k_cycle_get_32();
  // start_time_ = k_cycle_get_64();
  timing_t start_time, end_time;
  // printk("start_time_=%llu", start_time_);
  start_time = timing_counter_get();
  mlif_run();
  // stop_time = k_cycle_get_32();
  // stop_time_ = k_cycle_get_64();
  end_time = timing_counter_get();
  uint64_t cycles = timing_cycles_get(&start_time, &end_time);
  uint64_t ns_spent = timing_cycles_to_ns(cycles);
  // printk("stop_time_=%llu", stop_time_);

  /* compute how long the work took (assumes no counter rollover) */
  // if (start_time >= stop_time) {
  //     cycles_spent_ = stop_time - start_time;
  // } else {
  //     cycles_spent_ = stop_time + ((1 << 31) - start_time);
  // }
  // cycles_spent_ = stop_time_ - start_time_;
  // nanoseconds_spent = k_cyc_to_ns_ceil32(cycles_spent);
  // nanoseconds_spent_ = k_cyc_to_ns_ceil64(cycles_spent_);
  // printk("Total Time: %u us\n", (uint32_t) (nanoseconds_spent/1000));
  printk("Total Time: %llu us\n", (ns_spent/1000));
  // printk("Total Cycles: %u\n", cycles_spent);
  printk("Total Cycles: %llu\n", cycles);
  printk("MLonMCU: STOP\n");
  // deinit_target();
  sys_reboot(0);
  return 0;
}
//
// /* do work for some (short) period of time */
// ...
//
// /* capture final time stamp */
// stop_time = k_cycle_get_32();
//
// /* compute how long the work took (assumes no counter rollover) */
// cycles_spent = stop_time - start_time;
// nanoseconds_spent = SYS_CLOCK_HW_CYCLES_TO_NS(cycles_spent);
```
