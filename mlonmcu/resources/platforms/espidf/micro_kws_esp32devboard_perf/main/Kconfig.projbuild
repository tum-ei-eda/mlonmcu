## mlonmcu/resources/platforms/espidf/micro_kws_esp32devboard_perf/main/Kconfig.projbuild
```kconfig
menu "MicroKWS Options"

    menu "MicroKWS Hyperparameters"
        config MICRO_KWS_NUM_BINS
            int "Number of used bins in spectrogram"
            default 40
            help
                Configure the bins used according to the model hyperparameters

        config MICRO_KWS_NUM_SLICES
            int "Number of time slices in the spectrogram"
            default 49
            help
                Configure the slices used according to the model hyperparameters

        config MICRO_KWS_WINDOW_SIZE_MS
            int "Size of the window used for preprocessing in ms"
            default 30
            help
                Configure ms used for the FFT window.

        config MICRO_KWS_STRIDE_SIZE_MS
            int "Stride of preprocessing window in ms"
            default 20
            help
                Configure ms used for the FFT stride.
    endmenu

    config MICRO_KWS_MAX_RATE
        int "Maximum number of inferences per second"
        default 100
        help
            Limit number of inferences per second to reduce CPU load
            and make posterior handling more reliable for tiny models.

    menu "MicroKWS Posterior Handler Parameters"
        config MICRO_KWS_POSTERIOR_SUPPRESSION_MS
            int "Suppression time in ms for Posterior Handler"
            default 1000
            help
                Blocks detections in the same category which are close to each other.

        config MICRO_KWS_POSTERIOR_HISTORY_LENGTH
            int "History length of the Posterior Handler"
            default 35
            help
                A larger history needs more memory but can be helpful to filter short spikes
                in wrong categories. This value has to be adapted to the inference frequency in the main loop.

        config MICRO_KWS_POSTERIOR_TRIGGER_THRESHOLD_SINGLE
            int "Trigger threshold for the Posterior Handler"
            default 130
            help
                This value will be multiplied with MICRO_KWS_POSTERIOR_HISTORY_LENGTH.
    endmenu

    config MICRO_KWS_NUM_CLASSES
        int "Number of classes"
        range 2 12
        default 4
        help
            Number of classes used in KWS model.

    menu "MicroKWS Class Labels"

        config MICRO_KWS_CLASS_LABEL_0
            string "MLF Class 0 Label"
            default "silence"
            help
                Configure the label for class 0 (hardcoded).

        config MICRO_KWS_CLASS_LABEL_1
            string "MLF Class 1 Label"
            default "unknown"
            help
                Configure the label for class 1 (hardcoded).

        config MICRO_KWS_CLASS_LABEL_2
            string "MLF Class 2 Label"
            depends on MICRO_KWS_NUM_CLASSES >=3
            default "yes"
            help
                Configure the label for class 2.

        config MICRO_KWS_CLASS_LABEL_3
            string "MLF Class 3 Label"
            depends on MICRO_KWS_NUM_CLASSES >=4
            default "no"
            help
                Configure the label for class 3.

        config MICRO_KWS_CLASS_LABEL_4
            string "MLF Class 4 Label"
            depends on MICRO_KWS_NUM_CLASSES >=5
            default "???"
            help
                Configure the label for class 4.

        config MICRO_KWS_CLASS_LABEL_5
            string "MLF Class 5 Label"
            depends on MICRO_KWS_NUM_CLASSES >=6
            default "???"
            help
                Configure the label for class 5.

        config MICRO_KWS_CLASS_LABEL_6
            string "MLF Class 6 Label"
            depends on MICRO_KWS_NUM_CLASSES >=7
            default "???"
            help
                Configure the label for class 6.

        config MICRO_KWS_CLASS_LABEL_7
            string "MLF Class 7 Label"
            depends on MICRO_KWS_NUM_CLASSES >=8
            default "???"
            help
                Configure the label for class 7.

        config MICRO_KWS_CLASS_LABEL_8
            string "MLF Class 8 Label"
            depends on MICRO_KWS_NUM_CLASSES >=9
            default "???"
            help
                Configure the label for class 8.

        config MICRO_KWS_CLASS_LABEL_9
            string "MLF Class 9 Label"
            depends on MICRO_KWS_NUM_CLASSES >=10
            default "???"
            help
                Configure the label for class 9.

        config MICRO_KWS_CLASS_LABEL_10
            string "MLF Class 10 Label"
            depends on MICRO_KWS_NUM_CLASSES >=11
            default "???"
            help
                Configure the label for class 10.

        config MICRO_KWS_CLASS_LABEL_11
            string "MLF Class 11 Label"
            depends on MICRO_KWS_NUM_CLASSES >=12
            default "???"
            help
                Configure the label for class 11.
    endmenu

    menu "MicroKWS Debug Settings"


        choice MICRO_KWS_MODE
            prompt "Mode for MicroKWS Execution"
            default MICRO_KWS_MODE_DEFAULT
            help
                Choose a mode from the list:
                - Default: Normal execution using serial console for printing text.
                - Debug: Can be used for debugging the model inputs and outputs.
                - Audio: This mode enables recording and sending a short audio sample from the device to the computer via the serial connection.
            config MICRO_KWS_MODE_DEFAULT
                bool "Default: Console only"
            config MICRO_KWS_MODE_DEBUG
                bool "Debug: Stream data to debugger GUI (Needs disabled console)"
            config MICRO_KWS_MODE_DEBUG_AUDIO
                bool "Audio: Record audio on device and send it to host client (Needs disabled console)"
        endchoice

        config MICRO_KWS_PRINT_OUTPUTS
            bool "Print inference results directly to the serial monitor."
            default y
            help
            Can be used for debugging the model without any postprocessing.

        config MICRO_KWS_PRINT_TIME
            bool "Print measured time between inferences to the serial monitor (in ms)."
            default y
            help
            Can be used for debugging the models performance.

        config MICRO_KWS_PRINT_STATS
            bool "Print FreeRTOS Task Stats."
            depends on FREERTOS_GENERATE_RUN_TIME_STATS
            default n
            help
            Can be used for debugging the CPU load.

        config MICRO_KWS_PRINT_STATS_INTERVAL
            int "Interval between print of stats (in ms)."
            depends on MICRO_KWS_PRINT_STATS
            default 5000
            help
            Number of ms between print of stats.

        # config MICRO_KWS_SEND_DATA
        #     bool "Stream binary data to Python debugger application (disable all other UART and print options)."
        #     default n
        #     help
        #     Can be used for debugging the model inputs and outputs.

        config MICRO_KWS_LED_RAW_POSTERIORS
            bool "Use raw posterior values from model for RGB led and disable backend."
            default n
            help
            Can be used for debugging the model outputs.

        # config MICRO_KWS_MICROPHONE_DEBUG_MODE
        #     bool "Enter microphone debug mode after startup."
        #     default n
        #     help
        #     This mode enables recording and sending a short audio sample from the device to the computer via the serial connection.

    endmenu


endmenu


# Added WiFi station configuration
menu "WiFi Configuration"
    
    config ESP_WIFI_SSID
        string "WiFi SSID"
        default "EDA_RPi_hotspot"
        help
            SSID (network name) for the ESP32 to connect to.
   
    config ESP_WIFI_PASSWORD
        string "WiFi Password"
        default "ed@Rp!25"
        help
            WiFi password (WPA or WPA2) for the ESP32 to use.
   choice ESP_WIFI_AUTH_MODE
        prompt "WiFi Authentication Mode"
        default ESP_WIFI_AUTH_WPA_PSK
        help
            WiFi authentication mode. Default is set to WPA for connecting to RPi.

        config ESP_WIFI_AUTH_OPEN
            bool "OPEN"
        config ESP_WIFI_AUTH_WEP
            bool "WEP"
        config ESP_WIFI_AUTH_WPA_PSK
            bool "WPA PSK"
        config ESP_WIFI_AUTH_WPA2_PSK
            bool "WPA2 PSK"
        config ESP_WIFI_AUTH_WPA_WPA2_PSK
            bool "WPA/WPA2 PSK"
        config ESP_WIFI_AUTH_WPA3_PSK
            bool "WPA3 PSK"
        config ESP_WIFI_AUTH_WPA2_WPA3_PSK
            bool "WPA2/WPA3 PSK"
        config ESP_WIFI_AUTH_WAPI_PSK
            bool "WAPI PSK"
    endchoice

    config ESP_WIFI_MAXIMUM_RETRY
        int "Maximum retry"
        default 5
        help
            Set the Maximum retry to avoid station reconnecting to the AP unlimited when the AP is really inexistent.

    config ESP_UDP_SERVER_IP
        string "UDP SERVER IP Address"
        default "10.42.0.1"
        help
            IP Address of the UDP server to send packets.
   
    config ESP_UDP_SERVER_PORT
        int "UDP SERVER Port number"
        default 12345
        help
            UDP server port number to use.

endmenu
```

## mlonmcu/resources/platforms/espidf/project/components/tflite-lib/Kconfig
```kconfig
menu "TFLite Micro Build Options"
    
    config TF_DIR
        string "Path to TFLite Micro"
        default "$(TF_SRC)"
        help
            TFLite Micro directory path.
endmenu
```

## mlonmcu/resources/platforms/espidf/project/sdkconfig.defaults
```kconfig
CONFIG_ESP_TASK_WDT_TIMEOUT_S=60
#
# MLonMCU Options
#
CONFIG_MLONMCU_CODEGEN_DIR=""
CONFIG_MLONMCU_FRAMEWORK_TFLM=y
CONFIG_MLONMCU_FRAMEWORK_TVM=n
CONFIG_MLONMCU_BACKEND_TFLMI=y
CONFIG_MLONMCU_BACKEND_TFLMC=n
CONFIG_MLONMCU_BACKEND_TVMAOT=n
CONFIG_MLONMCU_BACKEND_TVMRT=n
CONFIG_MLONMCU_BACKEND_TVMCG=n
CONFIG_MLONMCU_NUM_RUNS=1
# end of MLonMCU Options

#
# TFLite Micro Build Options
#
CONFIG_TF_DIR=""
# end of TFLite Micro Build Options

#
# TVM Build Options
#
CONFIG_TVM_DIR=""
# end of TVM Build Options
```

## resources/platforms/espidf/micro_kws_esp32devboard_perf/components/tvm-lib/Kconfig
```kconfig
menu "TVM Build Options"
    config TVM_DIR
        string "Path to TVM"
        default "$(TVM_SRC)"
        help
            TVM directory path.
    config TVM_CRT_CONFIG_DIR
        string "Path to crt_config"
        default "crt_config"
        help
            TVM crt_config path.
endmenu
```

## resources/platforms/espidf/micro_speech_esp32devboard/components/mlif2/Kconfig
```kconfig
menu "MLonMCU Options"

    config MLONMCU_CODEGEN_DIR
        string "Codegen Directory"
        default "$(CODEGEN_SRC)"
        help
            Path to the directory with the codegen results.

    choice MLONMCU_FRAMEWORK
        prompt "MLonMCU framework"
        default MLONMCU_FRAMEWORK_TFLM
        help
            Choose a MLonMCU framework from the list.

        config MLONMCU_FRAMEWORK_TFLM
            bool "TFLite Micro"
        config MLONMCU_FRAMEWORK_TVM
            bool "TVM"
    endchoice

    config MLONMCU_FRAMEWORK
        string
        default "tflm" if MLONMCU_FRAMEWORK_TFLM
        default "tvm" if MLONMCU_FRAMEWORK_TVM

    choice MLONMCU_BACKEND
        prompt "MLonMCU backend"
        default MLONMCU_BACKEND_TFLMI if MLONMCU_FRAMEWORK_TFLM
        default MLONMCU_BACKEND_TVMAOT if MLONMCU_FRAMEWORK_TVM
        help
            Choose a MLonMCU backend for the chosen framwork.

        config MLONMCU_BACKEND_TFLMI
            bool "TFLite Micro Default Interpreter"
            depends on MLONMCU_FRAMEWORK_TFLM
        config MLONMCU_BACKEND_TFLMC
            bool "TFLite Micro Compiler"
            depends on MLONMCU_FRAMEWORK_TFLM
        config MLONMCU_BACKEND_TVMAOT
            bool "TVM AoT Executor"
            depends on MLONMCU_FRAMEWORK_TVM
        config MLONMCU_BACKEND_TVMRT
            bool "TVM Graph Executor"
            depends on MLONMCU_FRAMEWORK_TVM
        config MLONMCU_BACKEND_TVMCG
            bool "TVM Custom Codegenerator"
            depends on MLONMCU_FRAMEWORK_TVM
    endchoice

    config MLONMCU_BACKEND
        string
        default "tflmi" if MLONMCU_BACKEND_TFLMI
        default "tflmc" if MLONMCU_BACKEND_TFLMC
        default "tvmaot" if MLONMCU_BACKEND_TVMAOT
        default "tvmrt" if MLONMCU_BACKEND_TVMRT
        default "tvmcg" if MLONMCU_BACKEND_TVMCG

    config MLONMCU_NUM_RUNS
        int "Number of inferences"
        default 1
        help
            How many times the network should be invoked. A negative value maps to a infinite number of runs.

    config MLONMCU_VALIDATE
        bool "Validate model output data"
        default false
        help
            Compare model outputs with expected results (if available). Only works in DEBUG mode.

    config MLONMCU_MODLE_DIR
        string "Model Directory"
        depends on MLONMCU_VALIDATE
        default "$(MODEL_DIR)"
        help
            Directory where model support code and reference data can be found.
endmenu
```

## resources/platforms/espidf/micro_speech_esp32devboard/components/tvm-lib/Kconfig
```kconfig
menu "TVM Build Options"
    config TVM_DIR
        string "Path to TVM"
        default "$(TVM_SRC)"
        help
            TVM directory path.
endmenu
```
